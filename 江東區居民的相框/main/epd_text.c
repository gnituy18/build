#include "epd.h"

#include <stdlib.h>
#include <string.h>
#include <esp_log.h>

static const char *TAG = "epd_txt";

static void draw_string(uint8_t *buf, int x, int y, const char *s, int scale, uint8_t fg);
static void draw_char(uint8_t *buf, int x, int y, char c, int scale, uint8_t fg);
static void put_px(uint8_t *buf, int x, int y, uint8_t color);

void epd_show_message(const char *const *lines, int n_lines, uint8_t fg, uint8_t bg)
{
    uint8_t *buf = malloc(EPD_BUFFER_SIZE);
    if (!buf) {
        ESP_LOGE(TAG, "no heap for message buffer");
        return;
    }
    memset(buf, (bg << 4) | bg, EPD_BUFFER_SIZE);

    /* Largest scale (capped at 6) that keeps the widest line on screen */
    int scale = 6;
    for (int i = 0; i < n_lines; i++) {
        int len = (int)strlen(lines[i]);
        while (scale > 1 && len * 8 * scale > EPD_WIDTH - 16) scale--;
    }

    int line_h = 8 * scale + scale * 2;
    int top = (EPD_HEIGHT - n_lines * line_h) / 2;
    if (top < 0) top = 0;

    for (int i = 0; i < n_lines; i++) {
        int text_w = (int)strlen(lines[i]) * 8 * scale;
        int x = (EPD_WIDTH - text_w) / 2;
        if (x < 0) x = 0;
        draw_string(buf, x, top + i * line_h, lines[i], scale, fg);
    }

    epd_init();
    epd_display(buf, EPD_BUFFER_SIZE);
    epd_sleep();
    free(buf);
}

static void draw_string(uint8_t *buf, int x, int y, const char *s, int scale, uint8_t fg)
{
    for (int cx = x; *s; s++, cx += 8 * scale) {
        draw_char(buf, cx, y, *s, scale, fg);
    }
}

/* Public-domain 8x8 bitmap font (Daniel Hepper / IBM VGA), printable ASCII
 * 0x20–0x7E only. Each glyph is 8 rows; within a row bit 0 is the leftmost
 * pixel. Indexed by (c - 0x20). */
static const unsigned char FONT8X8[95][8] = {
    {0x00,0x00,0x00,0x00,0x00,0x00,0x00,0x00}, /* (space) */
    {0x18,0x3C,0x3C,0x18,0x18,0x00,0x18,0x00}, /* ! */
    {0x36,0x36,0x00,0x00,0x00,0x00,0x00,0x00}, /* " */
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    {0x6E,0x3B,0x00,0x00,0x00,0x00,0x00,0x00}, /* ~ */
};

/* Each font pixel expands to scale×scale panel pixels */
static void draw_char(uint8_t *buf, int x, int y, char c, int scale, uint8_t fg)
{
    if (c < 0x20 || c > 0x7E) c = '?';
    const unsigned char *glyph = FONT8X8[(int)c - 0x20];
    for (int row = 0; row < 8; row++) {
        unsigned char bits = glyph[row];
        for (int col = 0; col < 8; col++) {
            if (bits & (1u << col)) {
                for (int dy = 0; dy < scale; dy++)
                    for (int dx = 0; dx < scale; dx++)
                        put_px(buf, x + col * scale + dx, y + row * scale + dy, fg);
            }
        }
    }
}

/* Pack one 4-bit color (2 px/byte, high nibble = left pixel); clips silently */
static void put_px(uint8_t *buf, int x, int y, uint8_t color)
{
    if (x < 0 || x >= EPD_WIDTH || y < 0 || y >= EPD_HEIGHT) return;
    int idx = (y * EPD_WIDTH + x) / 2;
    if (x & 1) {
        buf[idx] = (buf[idx] & 0xF0) | (color & 0x0F);
    } else {
        buf[idx] = (buf[idx] & 0x0F) | ((color & 0x0F) << 4);
    }
}
